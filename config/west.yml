## config/west.yml
```yaml
manifest:
  remotes:
    - name: zmkfirmware
      url-base: https://github.com/zmkfirmware
    - name: tmbutcher
      url-base: https://github.com/tmbutcher
    - name: urob
      url-base: https://github.com/urob
  projects:
    - name: zmk
      remote: zmkfirmware
      revision: main
      import: app/west.yml
    
    # My Keyboards
    - name: demo_dactyl
      remote: tmbutcher
      revision: main
      import: config/west.yml

    - name: Empire-Keyboard
      remote: tmbutcher
      revision: main

  self:
    path: config
```
