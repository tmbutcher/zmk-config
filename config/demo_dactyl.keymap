#include <behaviors.dtsi>
#include <dt-bindings/zmk/keys.h>
#include <dt-bindings/zmk/bt.h>
#include <dt-bindings/zmk/outputs.h>
#include <dt-bindings/zmk/ext_power.h>

// Layer Defs
#define DEF		0
#define DEF_NM	1
#define WORK	2
#define OHAND	3
#define QWERTY	4
#define QWER_NM	5
#define NUM		6
#define LNUM	7
#define SYM		8
#define NAV		9
#define MOUSE	10	
#define FN		11	// Reserved for future use 
#define EMOJI	12	// Reserved for future use
#define CMP		13
#define STAY	14

// F Key subs (use with AHK)
#define KP_PLS	(F18)
#define KP_COM	(F19)
#define KP_SMC	(F20)
#define KP_EMJ	(F21)
#define KP_CMP	(F23)
#define KP_SLP	(LG(LA(LS(LC(APOS)))))

// Other defs
#define xxx		&none	
#define ___		&trans
#define HYPER	(LG(LA(LS(LCTRL))))		  // If I want to send a hypered key, then I might need to make a custom behavior
// #define HYPER	(LG(LA(LS(LCTRL))))   // Maybe try to make a custom mod kp?

#include <../boards/shields/demo_dactyl/key_positions.h>
#include <../boards/shields/demo_dactyl/mouse.dtsi>
#include <../boards/shields/demo_dactyl/helper.h>
#include <../boards/shields/demo_dactyl/behaviors.dtsi>
#include <../boards/shields/demo_dactyl/combos.dtsi>
#include <../boards/shields/demo_dactyl/private.dtsi>

&mt { quick_tap_ms = <200>; };
&lt { quick_tap_ms = <200>; };

/ {
	conditional_layers {
        compatible = "zmk,conditional-layers";
        tri_layer {
            if-layers = <1 4>;
            then-layer = <5>;
        };
    };

    keymap {
        compatible = "zmk,keymap";

		default_layer { 
			display-name = "Default";
			bindings = <
//----------------------------------------------------------------------COLEMAK---------------------------------------------------------------------------------
//╭─────────────┬─────────────┬─────────────┬─────────────┬─────────────╮	  ╭─────────────┬─────────────┬─────────────┬─────────────┬─────────────╮
	&kp N1		  &kp N2		&kp N3		  &kp N4		&kp N5				&kp N6		  &kp N7		&kp N8		  &kp N9		&kp N0
//├─────────────┼─────────────┼─────────────┼─────────────┼─────────────┤	  ├─────────────┼─────────────┼─────────────┼─────────────┼─────────────┤
  	&kp Q		  &kp W			&kp F		  &kp P			&kp B				&kp J		  &kp L			&kp U		  &kp Y			&lt STAY APOS		// &tdq
//├─────────────┼─────────────┼─────────────┼─────────────┼─────────────┤     ├─────────────┼─────────────┼─────────────┼─────────────┼─────────────┤
  	&cm LWIN A	  &cm LALT R	&cm LSHFT S	  &cm LCTRL T	&lt LNUM G			&kp M		  &cm RCTRL N	&cm RSHFT E	  &cm RALT I	&cm RWIN O
//├─────────────┼─────────────┼─────────────┼─────────────┼─────────────┤     ├─────────────┼─────────────┼─────────────┼─────────────┼─────────────┤
	&kp Z		  &kp X			&kp C		  &kp D			&kp V				&kp K		  &kp H			&comcol		  &dotcol		&kp SLASH
//╰─────────────┴─────────────┼─────────────┼─────────────┼─────────────┤     ├─────────────┼─────────────┼─────────────┼─────────────┴─────────────╯
						     &lt FN hometab	  &sm NAV LSHFT	&lt MOUSE TAB		&backdel	 &shm RSHFT SPACE &lt OHAND END
//					 		  ╰─────────────┴─────────────╮─────────────┤	  ├─────────────╭─────────────┴─────────────╯
										    				&lt STAY ESC		&lt NUM RET
//														  ╰─────────────╯	  ╰─────────────╯
				>;
		};

		default_no_mods_layer { // Just turns off homerow mods, so no need for the whole keymap diagram
			display-name = "D.NoMods";
			bindings = <___ ___	___ ___ ___    ___ ___ ___ ___ ___
						___ ___	___ ___ ___    ___ ___ ___ ___ ___
						&kp A &kp R &kp S &kp T    &kp G ___ &kp N &kp E &kp I &kp O
						___ ___ ___ ___ ___    ___ ___ ___ ___ ___
						___ &kp SPACE ___ ___    ___ ___ ___ ___>;

		};

		work_layer { // Same as normal layer, except with some special combos
			display-name = "Work";
			bindings = <___ ___	___ ___ ___    ___ ___ ___ ___ ___
						___ ___	___ ___ ___    ___ ___ ___ ___ ___
						___ ___ ___ ___ ___    ___ ___ ___ ___ ___
						___ ___ ___ ___ ___    ___ ___ ___ ___ ___
							___ ___ ___ ___    ___ ___ ___ ___>;

		};
				>;
		};

		one_hand_layer { 
			display-name = "One Handed";
			bindings = <
//---------------------------------------------------------------------ONE HAND----------------------------------------------------------------------
//╭─────────────┬─────────────┬─────────────┬─────────────┬─────────────╮	  ╭─────────────┬─────────────┬─────────────┬─────────────┬─────────────╮
	&kp N0		  &kp N9		&kp N8		  &kp N7		&kp N6				&kp N5		  &kp N4		&kp N3		  &kp N2		&kp N1
//├─────────────┼─────────────┼─────────────┼─────────────┼─────────────┤	  ├─────────────┼─────────────┼─────────────┼─────────────┼─────────────┤
  	&lt STAY APOS &kp Y			&kp U		  &kp L			&kp J				&kp B		  &kp P			&kp F		  &kp W			&kp Q
//├─────────────┼─────────────┼─────────────┼─────────────┼─────────────┤     ├─────────────┼─────────────┼─────────────┼─────────────┼─────────────┤
  	&cm RWIN O	  &cm RALT I	&cm RSHFT E	  &cm RCTRL N   &kp M				&lt LNUM G	  &cm LCTRL T	&cm LSHFT S	  &cm LALT R	&cm LWIN A
//├─────────────┼─────────────┼─────────────┼─────────────┼─────────────┤     ├─────────────┼─────────────┼─────────────┼─────────────┼─────────────┤
	&kp SLASH	  &dotcol		&comcol		  &kp H			&kp K				&kp V		  &kp D			&kp C		  &kp X			&kp Z
//╰─────────────┴─────────────┼─────────────┼─────────────┼─────────────┤     ├─────────────┼─────────────┼─────────────┼─────────────┴─────────────╯
						     &lt OHAND END	&shm RSHFT SPACE &backdel			&lt MOUSE TAB &sm NAV LSHFT	&lt FN hometab	  				 
//					 		  ╰─────────────┴─────────────╮─────────────┤	  ├─────────────╭─────────────┴─────────────╯
										    				&kp RET				&lt NUM ESC		
//														  ╰─────────────╯	  ╰─────────────╯
				>;
		};

		qwerty_layer {
			display-name = "QWERTY";
			bindings = <
//----------------------------------------------------------------------QWERTY-----------------------------------------------------------------------
//╭─────────────┬─────────────┬─────────────┬─────────────┬─────────────╮	  ╭─────────────┬─────────────┬─────────────┬─────────────┬─────────────╮
	___			  ___			___			  ___			___					___			  ___			___			  ___			___
//├─────────────┼─────────────┼─────────────┼─────────────┼─────────────┤	  ├─────────────┼─────────────┼─────────────┼─────────────┼─────────────┤
	&kp Q		  &kp W			&kp E		  &kp R			&kp T				&kp Y		  &kp U			&kp I		  &kp O		    &kp P
//├─────────────┼─────────────┼─────────────┼─────────────┼─────────────┤     ├─────────────┼─────────────┼─────────────┼─────────────┼─────────────┤
	&cm LWIN A	  &cm LALT S	&cm LSHFT D	  &cm LCTRL F	&lt LNUM			&kp H		  &cm RCTRL K	&cm RSHFT L	 &cm RALT COLON &kp APOS
//├─────────────┼─────────────┼─────────────┼─────────────┼─────────────┤     ├─────────────┼─────────────┼─────────────┼─────────────┼─────────────┤
	&kp Z		  &kp X			&kp C		  &kp V			&kp B				&kp N		  &kp M		  	&kp COMMA	  &kp DOT		&kp SLASH
//╰─────────────┴─────────────┼─────────────┼─────────────┼─────────────┤     ├─────────────┼─────────────┼─────────────┼─────────────┴─────────────╯
						     &lt FN hometab	  &sm NAV LSHFT	&lt MOUSE TAB		&backdel	 &shm RSHFT SPACE &lt OHAND END
//					 		  ╰─────────────┴─────────────╮─────────────┤	  ├─────────────╭─────────────┴─────────────╯
										    				&lt STAY ESC		&lt NUM RET
//														  ╰─────────────╯	  ╰─────────────╯
				>;
		};

		qwerty_no_mods_layer { // Just turns off homerow mods, so no need for the whole keymap diagram
			display-name = "QNoMods";
			bindings = <___ ___ ___ ___ ___ ___ ___ ___ ___ ___
						___ ___	___ ___ ___ ___ ___ ___ ___ ___
						&kp A &kp S &kp D &kp F &kp G ___ &kp K &kp L &kp COLON &kp APOS
						___ ___ ___ ___ ___    ___ ___ ___ ___ ___
						___ &kp SPACE ___ ___    ___ ___ ___ ___>;
		};

		number_layer {
			display-name = "Numbers";
			bindings = < // All numbers use auto-shift for symbols
//----------------------------------------------------------------------NUMBERS---------------------------------------------------------------------
//╭─────────────┬─────────────┬─────────────┬─────────────┬─────────────╮	  ╭─────────────┬─────────────┬─────────────┬─────────────┬─────────────╮
	xxx			  xxx			&kp	KP_SLASH  &kp KP_ASTERISK &as UNDER MINUS	xxx			  xxx			xxx			  xxx			xxx
//├─────────────┼─────────────┼─────────────┼─────────────┼─────────────┤	  ├─────────────┼─────────────┼─────────────┼─────────────┼─────────────┤
	&as LBRC LBKT &as AMPS N7	&as ASTRK N8  &as LPAR N9 	&revplus			&as PIPE BSLH &as TILDE GRAVE xxx		  xxx			xxx
//├─────────────┼─────────────┼─────────────┼─────────────┼─────────────┤     ├─────────────┼─────────────┼─────────────┼─────────────┼─────────────┤
	&kp TAB		  &as DLLR N4	&as PRCNT N5  &as CARET N6	&revplus			&kp BSPC	  &kp RCTRL		&kp RSHFT	  &kp RALT		&kp RWIN
//├─────────────┼─────────────┼─────────────┼─────────────┼─────────────┤     ├─────────────┼─────────────┼─────────────┼─────────────┼─────────────┤
	&as RBRC RBKT &as EXCL N1	&as AT N2	  &as HASH N3	&as QMARK SLASH	  	xxx			  xxx		 &as KP_SMC COMMA &as COLON DOT &as BSLH SLASH
//╰─────────────┴─────────────┼─────────────┼─────────────┼─────────────┤     ├─────────────┼─────────────┼─────────────┼─────────────┴─────────────╯
						    	&kp SPACE	  &dotcom		&zeroleft			___			  ___			___
//					 		  ╰─────────────┴─────────────╮─────────────┤	  ├─────────────╭─────────────┴─────────────╯
										    				&as RPAR TAB		___
//														  ╰─────────────╯	  ╰─────────────╯
				>;
		};


		left_number_layer {
			display-name = "L Numbers";
			bindings = < // All numbers use auto-shift for symbols
//--------------------------------------------------------------------LEFT NUMBERS------------------------------------------------------------------
//╭─────────────┬─────────────┬─────────────┬─────────────┬─────────────╮	  ╭─────────────┬─────────────┬─────────────┬─────────────┬─────────────╮
	xxx			  xxx			xxx			  xxx			xxx					xxx			  xxx			&kp	KP_SLASH  &kp KP_ASTERISK &as UNDER MINUS
//├─────────────┼─────────────┼─────────────┼─────────────┼─────────────┤	  ├─────────────┼─────────────┼─────────────┼─────────────┼─────────────┤
	&as PIPE BSLH &as TILDE GRAVE xxx		  xxx			xxx					&as LBRC LBKT &as AMPS N7	&as ASTRK N8  &as LPAR N9	&as UNDER MINUS
//├─────────────┼─────────────┼─────────────┼─────────────┼─────────────┤     ├─────────────┼─────────────┼─────────────┼─────────────┼─────────────┤
	&kp BSPC	  &kp RCTRL	  	&kp RSHFT	  &kp RALT		&tog LNUM			&as RBRC RBKT &as DLLR N4	&as PRCNT N5  &as CARET N6  &revplus
//├─────────────┼─────────────┼─────────────┼─────────────┼─────────────┤     ├─────────────┼─────────────┼─────────────┼─────────────┼─────────────┤
	 xxx		  xxx			xxx			  &as PIPE BSLH &as TILDE GRAVE		&lgthan		  &as EXCL N1	&as AT N2	  &as HASH N3	&as QMARK SLASH
//╰─────────────┴─────────────┼─────────────┼─────────────┼─────────────┤     ├─────────────┼─────────────┼─────────────┼─────────────┴─────────────╯
						    	___			  ___			___					&zeroleft	  &dotcom		&kp SPACE	  					
//					 		  ╰─────────────┴─────────────╮─────────────┤	  ├─────────────╭─────────────┴─────────────╯
										    				___					&as RPAR TAB
//														  ╰─────────────╯	  ╰─────────────╯
				>;
		};

		symbol_layer {
			display-name = "Symbols"; // Haven't yet updated for Dactyl
			bindings = <
//---------------------------------------------------------------------------------SYMBOLS--------------------------------------------------------------------------------
//╭─────────────┬─────────────┬─────────────┬─────────────┬─────────────╮	 		  			    ╭─────────────┬─────────────┬─────────────┬─────────────┬─────────────╮
	&kp LBRC	  &kp AMPS		&kp ASTRK	  &kp LPAR		&kp UNDER					     		  &kp PIPE		&kp TILDE	  &kp UP			xxx			  xxx	
//├─────────────┼─────────────┼─────────────┼─────────────┼─────────────┤	 					    ├─────────────┼─────────────┼─────────────┼─────────────┼─────────────┤
	&kp RBRC	  &kp DLLR		&kp PRCNT	  &kp CARET		&kp EQUAL								  &kp BSPC		&kp LEFT	  &kp DOWN    	&kp RIGHT	  &kp RWIN
//├─────────────┼─────────────┼─────────────┼─────────────┼─────────────┤	   ╭─────────────╮      ├─────────────┼─────────────┼─────────────┼─────────────┼─────────────┤
	&kp GT		  &kp EXCL		&kp AT		  &kp HASH		&kp QMARK		  	 ___				  xxx			&kp LC(LEFT)  xxx			&kp LC(RIGHT)  xxx	
//├─────────────┴───┬─────────┼─────────────┼─────────────┼─────────────┬──────╰──────╮──────╯──────┬─────────────┼─────────────┼─────────────┴─────────┬───┴─────────────┤
	&to DEF						&dotcom		  &kp SPACE		&kp LPAR	  &kp RPAR	    ___			  ___			___			  ___						  &tog SYM
//╰─────────────────╯		  ╰─────────────┴─────────────┴─────────────┴─────────────╯─────────────┴─────────────┴─────────────┴─────────────╯	   		╰─────────────────╯
//																		  		 ╭─────────╮
																				   ___	
//																	   ╭─────────┼─────────┼─────────╮
																		 ___	   ___		 ___	
//																	   ╰─────────┼─────────┼─────────╯
																				   ___	
//																				 ╰─────────╯
			>;

			sensor-bindings = <&volume>;
		};

		navigation_layer {
			display-name = "Nav";
			bindings = <
//--------------------------------------------------------------------NAVIGATION--------------------------------------------------------------------
//╭─────────────┬─────────────┬─────────────┬─────────────┬─────────────╮	  ╭─────────────┬─────────────┬─────────────┬─────────────┬─────────────╮
	xxx			  xxx			xxx			  xxx			xxx					xxx			  xxx			xxx			  xxx			xxx
//├─────────────┼─────────────┼─────────────┼─────────────┼─────────────┤	  ├─────────────┼─────────────┼─────────────┼─────────────┼─────────────┤
	xxx			  xxx			xxx			  xxx			xxx					&msc S_UP     &kp HOME		&kp UP		  &kp END		&kp PG_UP
//├─────────────┼─────────────┼─────────────┼─────────────┼─────────────┤	  ├─────────────┼─────────────┼─────────────┼─────────────┼─────────────┤
  	&kp LWIN	  &kp LALT	 	&kp LSHFT	  &kp LCTRL		xxx					&msc S_DN  	  &kp LEFT		&kp DOWN      &kp RIGHT 	&kp PG_DN
//├─────────────┼─────────────┼─────────────┼─────────────┼─────────────┤     ├─────────────┼─────────────┼─────────────┼─────────────┼─────────────┤
	xxx			  xxx			xxx			  xxx			xxx				    xxx			  &kp LC(LEFT)  xxx			  &kp LC(RIGHT) xxx	
//╰─────────────┴─────────────┼─────────────┼─────────────┼─────────────┤     ├─────────────┼─────────────┼─────────────┼─────────────┴─────────────╯
								&kp RET		  ___			&tog NAV	  		&kp LC(BSPC)  ___			&kp LC(DEL)	
//					 		  ╰─────────────┴─────────────╮─────────────┤	  ├─────────────╭─────────────┴─────────────╯
										    				___					___
//														  ╰─────────────╯	  ╰─────────────╯
			>;

			sensor-bindings = <&tabs>;	// Scroll tabs
		};

		mouse_layer {
			display-name = "Mouse";
			bindings = <
//-----------------------------------------------------------------------MOUSE----------------------------------------------------------------------
//╭─────────────┬─────────────┬─────────────┬─────────────┬─────────────╮	  ╭─────────────┬─────────────┬─────────────┬─────────────┬─────────────╮
	xxx			  xxx			xxx			  xxx			xxx					xxx			  xxx			xxx			  xxx			xxx
//├─────────────┼─────────────┼─────────────┼─────────────┼─────────────┤	  ├─────────────┼─────────────┼─────────────┼─────────────┼─────────────┤
	xxx			  xxx			xxx			  xxx			xxx					&msc S_UP	  &msc S_LT		&mouse_u	  &msc S_RT 	xxx	
//├─────────────┼─────────────┼─────────────┼─────────────┼─────────────┤	  ├─────────────┼─────────────┼─────────────┼─────────────┼─────────────┤
	&kp LWIN	  &kp LALT		&kp LSHFT	  &kp LCTRL		&kp HYPER			&msc S_DN	  &mouse_l		&mouse_d	  &mouse_r		&kp RSHFT	
//├─────────────┼─────────────┼─────────────┼─────────────┼─────────────┤	  ├─────────────┼─────────────┼─────────────┼─────────────┼─────────────┤
	xxx			  xxx			xxx			  xxx			xxx					xxx			  xxx			xxx			  xxx			xxx
//╰─────────────┴─────────────┼─────────────┼─────────────┼─────────────┤     ├─────────────┼─────────────┼─────────────┼─────────────┴─────────────╯
								___			  ___			___			  		&mkp MCLK	  &mkp LCLK		&mkp RCLK
//					 		  ╰─────────────┴─────────────╮─────────────┤	  ├─────────────╭─────────────┴─────────────╯
										    				&tog MOUSE			___
//														  ╰─────────────╯	  ╰─────────────╯
			>;
		};

		function_layer {
			display-name = "Function";
			bindings = <
//---------------------------------------------------------------------FUNCTION---------------------------------------------------------------------
//╭─────────────┬─────────────┬─────────────┬─────────────┬─────────────╮	  ╭─────────────┬─────────────┬─────────────┬─────────────┬─────────────╮
	&kp F1		  &kp F2		&kp F3		  &kp F4		&kp F5				&kp F6		  &kp F7		&kp F8		  &kp F9		&kp F10
//├─────────────┼─────────────┼─────────────┼─────────────┼─────────────┤	  ├─────────────┼─────────────┼─────────────┼─────────────┼─────────────┤
	&kp F11		  &kp F12		&kp F13		  &kp F14		&kp F15				&kp F16		  &F1721		&F1822		  &F1923		&F2024
//├─────────────┼─────────────┼─────────────┼─────────────┼─────────────┤	  ├─────────────┼─────────────┼─────────────┼─────────────┼─────────────┤
	&kp LWIN	  &kp LALT	 &mt LSHFT LC(S)  &kp LCTRL		&kp HYPER			&kp C_VOL_UP  &kp LG(LEFT)	&kp LG(UP)	  &kp LG(DOWN)	&kp LG(DOWN)
//├─────────────┼─────────────┼─────────────┼─────────────┼─────────────┤	  ├─────────────┼─────────────┼─────────────┼─────────────┼─────────────┤
	&kp LC(Z)	  &kp LC(X)		&kp LC(C)	  &kp LC(V)		&kp LC(Y)			&kp	C_VOL_DN  &bootsleep	&bt BT_CLR	  &tdbt			&out OUT_TOG
//╰─────────────┴─────────────┼─────────────┼─────────────┼─────────────┤     ├─────────────┼─────────────┼─────────────┼─────────────┴─────────────╯
								___			  &kp LC(BSPC) &kp LC(DEL)			&cm C_RW C_PREV &cm C_STOP C_PP &cm C_FF C_NEXT
//					 		  ╰─────────────┴─────────────╮─────────────┤	  ├─────────────╭─────────────┴─────────────╯
										    				&kp RS(RG(S))		___
//														  ╰─────────────╯	  ╰─────────────╯
			>;
		};

		emoji_layer { // todo: Unicode (including emoji) not yet implemented in ZMK. Maybe try using AHK in the meantime?
			display-name = "Emoji";
			bindings = <
//----------------------------------------------------------------------------------EMOJI---------------------------------------------------------------------------------
//╭─────────────┬─────────────┬─────────────┬─────────────┬─────────────╮	 		  			    ╭─────────────┬─────────────┬─────────────┬─────────────┬─────────────╮
	&kp Q		  ___			___			  ___			___										  ___			___			  ___			___			  ___	
//├─────────────┼─────────────┼─────────────┼─────────────┼─────────────┤	 					    ├─────────────┼─────────────┼─────────────┼─────────────┼─────────────┤
	___			  ___			___			  ___			___										  ___			___			  ___			___			  ___	
//├─────────────┼─────────────┼─────────────┼─────────────┼─────────────┤	   ╭─────────────╮      ├─────────────┼─────────────┼─────────────┼─────────────┼─────────────┤
	___			  ___			___			  ___			___					 ___				  ___			___			  ___			___			  ___	
//├─────────────┴───┬─────────┼─────────────┼─────────────┼─────────────┬──────╰──────╮──────╯──────┬─────────────┼─────────────┼─────────────┴─────────┬───┴─────────────┤
	&to DEF		  				___			  &tog EMOJI	___			  ___			___			  ___			___			  ___						  ___	
//╰─────────────────╯		  ╰─────────────┴─────────────┴─────────────┴─────────────╯─────────────┴─────────────┴─────────────┴─────────────╯	   		╰─────────────────╯
//																		  		 ╭─────────╮
																				   ___	
//																	   ╭─────────┼─────────┼─────────╮
																		 ___	   ___		 ___	
//																	   ╰─────────┼─────────┼─────────╯
																				   ___	
//																				 ╰─────────╯
			>;


		};

		compose_layer { // todo: unicode not yet implemented in ZMK. Maybe try using AHK in the meantime?
			display-name = "Compose";
			bindings = <
//---------------------------------------------------------------------------------COMPOSE--------------------------------------------------------------------------------
//╭─────────────┬─────────────┬─────────────┬─────────────┬─────────────╮	 		  			    ╭─────────────┬─────────────┬─────────────┬─────────────┬─────────────╮
	&kp Q		  ___			___			  ___			___										  ___			___			  ___			___			  ___	
//├─────────────┼─────────────┼─────────────┼─────────────┼─────────────┤	 					    ├─────────────┼─────────────┼─────────────┼─────────────┼─────────────┤
	___			  ___			___			  ___			___										  ___			___			  ___			___			  ___	
//├─────────────┼─────────────┼─────────────┼─────────────┼─────────────┤	   ╭─────────────╮      ├─────────────┼─────────────┼─────────────┼─────────────┼─────────────┤
	___			  ___			___			  ___			___					 ___				  ___			___			  ___			___			  ___	
//├─────────────┴───┬─────────┼─────────────┼─────────────┼─────────────┬──────╰──────╮──────╯──────┬─────────────┼─────────────┼─────────────┴─────────┬───┴─────────────┤
	&tog EMOJI	  				___			  ___			___			  ___			___			  ___			___			  &tog CMP					  ___	
//╰─────────────────╯		  ╰─────────────┴─────────────┴─────────────┴─────────────╯─────────────┴─────────────┴─────────────┴─────────────╯	   		╰─────────────────╯
//																		  		 ╭─────────╮
																				   ___	
//																	   ╭─────────┼─────────┼─────────╮
																		 ___	   ___		 ___	
//																	   ╰─────────┼─────────┼─────────╯
																				   ___	
//																				 ╰─────────╯
			>;


		};

		stay_layer {	// This layer is for toggling the layers (rather than just holding them on). Can be replaced in the future with double-taps or something
			display-name = "Stay";
			bindings = <
//-------------------------------------------------------------------------------STAY  LAYER-------------------------------------------------------------------------------
//╭─────────────┬─────────────┬─────────────┬─────────────┬─────────────╮	 		  			    ╭─────────────┬─────────────┬─────────────┬─────────────┬─────────────╮
	&kp Q		  ___			___			  ___			___										  ___			___			  ___			___			  ___	
//├─────────────┼─────────────┼─────────────┼─────────────┼─────────────┤	 					    ├─────────────┼─────────────┼─────────────┼─────────────┼─────────────┤
	___			  ___			___			  ___			___										  ___			___			  ___			___			  ___	
//├─────────────┼─────────────┼─────────────┼─────────────┼─────────────┤	   ╭─────────────╮      ├─────────────┼─────────────┼─────────────┼─────────────┼─────────────┤
	___			  ___			___			  ___			___					 ___				  ___			___			  ___			___			  ___	
//├─────────────┴───┬─────────┼─────────────┼─────────────┼─────────────┬──────╰──────╮──────╯──────┬─────────────┼─────────────┼─────────────┴─────────┬───┴─────────────┤
	&tog FN						___			  &tog EMOJI	&tog NAV	  &tog MOUSE	&tog NUM	  &kp CAPS 		&tog CMP	  ___						  &tog SYM
//╰─────────────────╯		  ╰─────────────┴─────────────┴─────────────┴─────────────╯─────────────┴─────────────┴─────────────┴─────────────╯	   		╰─────────────────╯
//																		  		 ╭─────────╮
																				   ___	
//																	   ╭─────────┼─────────┼─────────╮
																		 ___	   ___		 ___	
//																	   ╰─────────┼─────────┼─────────╯
																				   ___	
//																				 ╰─────────╯
			>;


		};
	};
};
    };
 };